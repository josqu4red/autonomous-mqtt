## main/Kconfig.projbuild
```kconfig
menu "Autonomous controller configuration"

    orsource "$IDF_PATH/examples/common_components/env_caps/$IDF_TARGET/Kconfig.env_caps"

    config AUTONOMOUS_UART_NUM
        int "UART port number"
        range 0 2 if IDF_TARGET_ESP32 || IDF_TARGET_ESP32S3
        default 2 if IDF_TARGET_ESP32 || IDF_TARGET_ESP32S3
        range 0 1
        default 1
        help
            UART communication port number.
            See UART documentation for available port numbers.

    config AUTONOMOUS_UART_RXD
        int "UART RXD pin number"
        range ENV_GPIO_RANGE_MIN ENV_GPIO_IN_RANGE_MAX
        default 22 if IDF_TARGET_ESP32
        default 8 if !IDF_TARGET_ESP32
        help
            GPIO number for UART RX pin. See UART documentation for more information
            about available pin numbers for UART.

    config AUTONOMOUS_UART_TXD
        int "UART TXD pin number"
        range ENV_GPIO_RANGE_MIN ENV_GPIO_OUT_RANGE_MAX
        default 23 if IDF_TARGET_ESP32
        default 9 if !IDF_TARGET_ESP32
        help
            GPIO number for UART TX pin. See UART documentation for more information
            about available pin numbers for UART.

    config AUTONOMOUS_WIFI_SSID
        string "WiFi SSID"
        default "myssid"
        help
            SSID (network name) for the example to connect to.

    config AUTONOMOUS_WIFI_PASSWORD
        string "WiFi Password"
        default "mypassword"
        help
            WiFi password (WPA or WPA2) for the example to use.

    config AUTONOMOUS_WIFI_MAXIMUM_RETRY
        int "Maximum retry"
        default 5
        help
            Set the Maximum retry to avoid station reconnecting to the AP unlimited when the AP is really inexistent.

    choice AUTONOMOUS_WIFI_SCAN_AUTH_MODE_THRESHOLD
        prompt "WiFi Scan auth mode threshold"
        default AUTONOMOUS_WIFI_AUTH_WPA2_PSK
        help
            The weakest authmode to accept in the scan mode.

        config AUTONOMOUS_WIFI_AUTH_WPA_PSK
            bool "WPA PSK"
        config AUTONOMOUS_WIFI_AUTH_WPA2_PSK
            bool "WPA2 PSK"
        config AUTONOMOUS_WIFI_AUTH_WPA_WPA2_PSK
            bool "WPA/WPA2 PSK"
        config AUTONOMOUS_WIFI_AUTH_WPA3_PSK
            bool "WPA3 PSK"
        config AUTONOMOUS_WIFI_AUTH_WPA2_WPA3_PSK
            bool "WPA2/WPA3 PSK"
        config AUTONOMOUS_WIFI_AUTH_WAPI_PSK
            bool "WAPI PSK"
    endchoice
endmenu
```

## sdkconfig.defaults
```kconfig
CONFIG_LOG_DEFAULT_LEVEL=3
CONFIG_LOG_MAXIMUM_LEVEL=4
CONFIG_LOG_MAXIMUM_EQUALS_DEFAULT=n
```
